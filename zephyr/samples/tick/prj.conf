## CMakeLists.txt
```
# SPDX-License-Identifier: MIT
cmake_minimum_required(VERSION 3.20.0)
find_package(Zephyr REQUIRED HINTS $ENV{ZEPHYR_BASE})
project(riscitry_tick)
target_sources(app PRIVATE src/main.c)
```

## prj.conf
```kconfig
# Trimmed to fit the 16 KB RAM (code + data + stacks share it)
CONFIG_PRINTK=y
CONFIG_MAIN_STACK_SIZE=1024
CONFIG_ISR_STACK_SIZE=512
CONFIG_IDLE_STACK_SIZE=256
CONFIG_SYSTEM_WORKQUEUE_STACK_SIZE=512
CONFIG_ASSERT=n
CONFIG_THREAD_NAME=n
CONFIG_BOOT_BANNER=n
CONFIG_TIMESLICING=n
CONFIG_CBPRINTF_NANO=y
CONFIG_THREAD_STACK_INFO=n
CONFIG_THREAD_LOCAL_STORAGE=n

# Size trims (trial 2026-11-03): RAM 15,696 -> 13,936 B. NOT yet run in xsim or on the board.
CONFIG_TIMEOUT_64BIT=n
CONFIG_EXCEPTION_STACK_TRACE=n
CONFIG_STDOUT_CONSOLE=n
CONFIG_KERNEL_MEM_POOL=n
CONFIG_COMMON_LIBC_MALLOC=n
CONFIG_SYS_HEAP_HARDENING_NONE=y
CONFIG_ASSERT_VERBOSE=n
```

## src/main.c
```c
/* SPDX-License-Identifier: MIT */
#include <zephyr/kernel.h>
#include <zephyr/arch/cpu.h>
#include <zephyr/sys/sys_io.h>

#define SWITCHES DT_REG_ADDR(DT_NODELABEL(switches))

/* One line per period, from the machine timer: the first real use of the trap path.
 * The period is the middle DIP bank in milliseconds, 500 when it is 0 (so a simulated run can
 * ask for 1 ms and not wait hundreds of millions of clocks). */
int main(void)
{
	uint32_t ms = sys_read32(SWITCHES) & 0xFF;

	if (ms == 0) {
		ms = 500;
	}
	printk("tick up on %s\n", CONFIG_BOARD_TARGET);
	for (unsigned int n = 1; ; n++) {
		k_msleep(ms);
		printk("tick %u\n", n);
	}
	return 0;
}
```
