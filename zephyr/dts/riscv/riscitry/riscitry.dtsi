/* SPDX-License-Identifier: MIT */
/* RISCitry SoC: cpu + interrupt controller. Addresses come from the generated include below. */

/ {
	#address-cells = <1>;
	#size-cells = <1>;

	cpus {
		#address-cells = <1>;
		#size-cells = <0>;

		cpu0: cpu@0 {
			device_type = "cpu";
			compatible = "riscv";
			reg = <0>;
			riscv,isa = "rv32e_zicsr";
			clock-frequency = <25000000>;

			/* mie/mip: timer 7, external 11, platform lines 16 (UART RX) and 17 (counter). No PLIC. */
			cpu0_intc: interrupt-controller {
				compatible = "riscv,cpu-intc";
				#address-cells = <0>;
				#interrupt-cells = <1>;
				interrupt-controller;
			};
		};
	};
};

#include "riscitry-memmap.dtsi"
