## zephyr/boards/riscitry/alchitry_cu_io/alchitry_cu_io_defconfig
```kconfig
CONFIG_BUILD_OUTPUT_BIN=y
CONFIG_XIP=y
CONFIG_SERIAL=y
CONFIG_CONSOLE=y
CONFIG_UART_CONSOLE=y
```

## zephyr/boards/riscitry/alchitry_cu_io/board.yml
```yaml
boards:
  - name: alchitry_cu_io
    full_name: Alchitry Cu V2 + Io V2 (RISCitry)
    socs:
      - name: riscitry
```

## zephyr/drivers/serial/Kconfig
```kconfig
# SPDX-License-Identifier: MIT

config UART_RISCITRY
	bool "RISCitry UART"
	default y
	depends on DT_HAS_RISCITRY_UART_ENABLED
	select SERIAL_HAS_DRIVER
	help
	  Memory-mapped UART of the RISCitry soft core (source/computer/uart.luc). Polling only: the
	  baud rate is fixed in hardware, and the receive interrupt (platform line 0) is not used yet.
```

## zephyr/drivers/timer/Kconfig
```kconfig
# SPDX-License-Identifier: MIT

config TIMER_RISCITRY
	bool "RISCitry machine timer"
	default y
	depends on DT_HAS_RISCITRY_TIMER_ENABLED
	select TICKLESS_CAPABLE
	select TIMER_HAS_64BIT_CYCLE_COUNTER
	help
	  System clock on the RISCitry mtime/mtimecmp (source/computer/timer.luc). Same registers as
	  the generic RISC-V machine timer, but all divides and multiplies are 32-bit: the upstream
	  driver pulls in libgcc's 64-bit divide (1.6 KB), which matters in a 16 KB RAM that holds code
	  and data. Tickless only.
```

## zephyr/dts/bindings/riscitry/riscitry,buttons.yaml
```yaml
description: RISCitry buttons device (register layout in tools/memmap.py)
compatible: "riscitry,buttons"
include: base.yaml
properties:
  reg:
    required: true
```

## zephyr/dts/bindings/riscitry/riscitry,counter.yaml
```yaml
description: RISCitry counter device (register layout in tools/memmap.py)
compatible: "riscitry,counter"
include: base.yaml
properties:
  reg:
    required: true
```

## zephyr/dts/bindings/riscitry/riscitry,display.yaml
```yaml
description: RISCitry display device (register layout in tools/memmap.py)
compatible: "riscitry,display"
include: base.yaml
properties:
  reg:
    required: true
```

## zephyr/dts/bindings/riscitry/riscitry,led-dimmer.yaml
```yaml
description: RISCitry led-dimmer device (register layout in tools/memmap.py)
compatible: "riscitry,led-dimmer"
include: base.yaml
properties:
  reg:
    required: true
```

## zephyr/dts/bindings/riscitry/riscitry,switches.yaml
```yaml
description: RISCitry switches device (register layout in tools/memmap.py)
compatible: "riscitry,switches"
include: base.yaml
properties:
  reg:
    required: true
```

## zephyr/dts/bindings/riscitry/riscitry,timer.yaml
```yaml
description: RISCitry machine timer, mtime +0 / mtimecmp +8 (register layout in tools/memmap.py)
compatible: "riscitry,timer"
include: base.yaml
properties:
  reg:
    required: true
  reg-names:
    required: true
  interrupts-extended:
    required: true
```

## zephyr/dts/bindings/riscitry/riscitry,uart.yaml
```yaml
description: RISCitry UART (TXDATA +0, STATUS +4, RXDATA +8; the RXDATA read pops the byte)
compatible: "riscitry,uart"
include: [uart-controller.yaml, base.yaml]
properties:
  reg:
    required: true
  interrupts-extended:
    required: false
```

## zephyr/soc/riscitry/riscitry/Kconfig
```kconfig
# RISCitry SoC options

if SOC_RISCITRY

config RISCV_SOC_INTERRUPT_INIT
	bool
	default y

config NUM_IRQS
	int
	default 18
	help
	  Local interrupts only: 7 (timer), 11 (external), 16 (UART RX), 17 (counter). Bits above 17
	  of mie/mip are not implemented.

endif # SOC_RISCITRY
```
